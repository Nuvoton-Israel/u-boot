/dts-v1/;
#include <dt-bindings/clock/npcm750_poleg-clock.h>
#include <dt-bindings/gpio/gpio.h>
#include "nuvoton-npcm730.dts"
#include "nuvoton-npcm730-gsz-pincfg.dtsi"
/ {
	model = "Quanta npcm730 BMC Board (Device Tree v00.07)";
	compatible = "nuvoton,poleg", "quanta,gsz";

    config {
            espi-channel-support = <0xf>;
    };

	pinctrl: pinctrl@f0800000 {
		compatible = "nuvoton,npcm7xx-pinctrl";
		pinctrl-names = "default";
		pinctrl-0 = <
				&gpio0od_pins
				&gpio1pp_pins
				&gpio2pp_pins
				&gpio3pp_pins
				&gpio6od_pins
				&gpio7od_pins
				&gpio10od_pins
				&gpio11_pins
				&gpio12_pins
				&gpio13_pins
				&gpio15od_pins
				&gpio16_pins
				&gpio17_pins
				&gpio18_pins
				&gpio19_pins
				&gpio24_pins
				&gpio25_pins
				&gpio32pp_pins
				&gpio37pp_pins
				&gpio38_pins
				&gpio39_pins
				&gpio45_pins
				&gpio47_pins
				&gpio57_pins
				&gpio58_pins
				&gpio59od_pins
				&gpio60_pins
				&gpio64_pins
				&gpio65_pins
				&gpio66od_pins
				&gpio67od_pins
				&gpio68pp_pins
				&gpio69pp_pins
				&gpio70od_pins
				&gpio72od_pins
				&gpio73_pins
				&gpio74_pins
				&gpio75od_pins
				&gpio76_pins
				&gpio77_pins
				&gpio80pp_pins
				&gpio81pp_pins
				&gpio82od_pins
				&gpio83od_pins
				&gpio84od_pins
				&gpio85od_pins
				&gpio86od_pins
				&gpio87od_pins
				&gpio88pp_pins
				&gpio89od_pins
				&gpio90pp_pins
				&gpio91od_pins
				&gpio92od_pins
				&gpio94_pins
				&gpio110_pins
				&gpio111_pins
				&gpio112_pins
				&gpio113_pins
				&gpio120od_pins
				&gpio121_pins
				&gpio122_pins
				&gpio123_pins
				&gpio124_pins
				&gpio125pp_pins
				&gpio126od_pins
				&gpio127_pins
				&gpio138_pins
				&gpio139_pins
				&gpio140_pins
				&gpio143_pins
				&gpio145od_pins
				&gpio147od_pins
				&gpio160od_pins
				&gpio162_pins
				&gpio169_pins
				&gpio170od_pins
				&gpio187pp_pins
				&gpio190_pins
				&gpio191_pins
				&gpio192_pins
				&gpio197_pins
				&gpio198pp_pins
				&gpio199_pins
				&gpio200pp_pins
				&gpio205pp_pins
				&gpio206pp_pins
				&gpio207pp_pins
				&gpio208_pins
				&gpio209_pins
				&gpio210_pins
				&gpio211_pins
				&gpio212pp_pins
				&gpio213_pins
				&gpio214_pins
				&gpio215_pins
				&gpio216_pins
				&gpio218pp_pins
				&gpio219od_pins
				&gpio228_pins
				&gpio230_pins>;
	};
};
