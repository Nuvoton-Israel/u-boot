## arch/arm/mach-npcm/Kconfig
```kconfig
if ARCH_NPCM

config SYS_ARCH
	default "arm"

config SYS_TEXT_BASE
	default 0x8000

config NPCM_SECURE_BOOT
	bool "NPCM Secure Boot"
	default n

config NIST_VERSION_ADDR
	hex "Linux NIST version address"
	depends on NPCM_SECURE_BOOT
	default 0x0
	help
	  The address of the Linux NIST version, which should be identical
	  to the u-boot version.
choice
	prompt "Nuvoton SoC select"
	default ARCH_NPCM8XX

config ARCH_NPCM8XX
	bool "Support Nuvoton NPCM8xx SoC"
	select ARM64

config ARCH_NPCM7xx
	select CPU_V7A
	select OF_CONTROL
	select DM
	bool "Support Nuvoton NPCM7xx SoC"

endchoice

source "arch/arm/mach-npcm/npcm8xx/Kconfig"
source "arch/arm/mach-npcm/npcm7xx/Kconfig"

endif
```

## arch/arm/mach-npcm/npcm7xx/Kconfig
```kconfig
if ARCH_NPCM7xx

config TARGET_POLEG
    bool "POLEG board"

config SYS_CPU
        default "armv7"

config SYS_SOC
	default "npcm7xx"

config SYS_MEM_TOP_HIDE
	hex "Reserved TOP memory"
	default 0x03000000

source "board/nuvoton/poleg/Kconfig"

endif
```

## arch/arm/mach-npcm/npcm8xx/Kconfig
```kconfig
if ARCH_NPCM8XX

config SYS_CPU
	default "armv8"

config SYS_SOC
	default "npcm8xx"

config SYS_NPCM_DCACHE_OFF
	bool "Do not enable dcache"
	default n

config TARGET_ARBEL_EVB
	bool "Arbel Evaluation Board"
	help
	  ARBEL_EVB is Nuvoton evaluation board for NPCM845 SoC,
	  supports general functions of Basebase Management Controller
	  (BMC).

source "board/nuvoton/arbel_evb/Kconfig"

endif
```

## arch/arm/mach-nuvoton/npcm750/Kconfig
```kconfig
if ARCH_NPCM750

choice
	prompt "NPCM board select"

config TARGET_POLEG
    bool "POLEG board"

endchoice


config SYS_CPU
        default "armv7"

config SYS_SOC
	default "npcm750"

config SYS_MEM_TOP_HIDE
	hex "Reserved TOP memory"
	default 0x03000000

source "board/nuvoton/poleg/Kconfig"

endif
```

## board/nuvoton/arbel/Kconfig
```kconfig
if TARGET_ARBEL_EVB

config SYS_BOARD
	default "arbel"

config SYS_VENDOR
	default "nuvoton"

config SYS_CONFIG_NAME
	default "arbel"

config SYS_MEM_TOP_HIDE
	hex "Reserved TOP memory"
	default 0xB300000
	help
	  Reserve memory for ECC/GFX/OPTEE/TIP/CP.

endif
```

## board/nuvoton/arbel_evb/Kconfig
```kconfig
if TARGET_ARBEL_EVB

config SYS_BOARD
	default "arbel_evb"

config SYS_VENDOR
	default "nuvoton"

config SYS_CONFIG_NAME
	default "arbel"

config SYS_MEM_TOP_HIDE
	hex "Reserved TOP memory"
	default 0x0
	help
	  Reserve memory for ECC/GFX/OPTEE/TIP/CP.

config ENV_SPI_CS
	int "SPI Chip select for Normal boot ENV"
	default 0

config ENV_SPI_CS_RECOVERY
	int "SPI Chip select for Recovery boot ENV"
	default 1

source "board/nuvoton/common/Kconfig"
endif
```

## board/nuvoton/poleg/Kconfig
```kconfig
if TARGET_POLEG

config SYS_BOARD
	default "poleg"

config SYS_VENDOR
	default "nuvoton"

config SYS_CONFIG_NAME
	default "poleg"

config NIST_VERSION_ADDR
	hex "Linux NIST version address"
	default 0x0
	help
	  The address of the Linux NIST version, which should be identical
	  to the u-boot version.

choice
	prompt "Target board select"
	default TARGET_POLEG_EVB
config TARGET_POLEG_EVB
	bool "Poleg EVB"

config TARGET_POLEG_RUNBMC
	bool "Poleg RunBMC"

endchoice

endif
```

## configs/ArbelEVB_defconfig
```kconfig
CONFIG_ARM=y
CONFIG_ARCH_NPCM=y
CONFIG_ARCH_NPCM8XX=y
CONFIG_TARGET_ARBEL_EVB=y
CONFIG_SYS_TEXT_BASE=0x8000
CONFIG_DEFAULT_DEVICE_TREE="nuvoton-npcm850-evb"
CONFIG_ENV_IS_IN_SPI_FLASH=y
CONFIG_ENV_SIZE=0x10000
CONFIG_ENV_OFFSET=0x100000
CONFIG_ENV_SECT_SIZE=0x1000
CONFIG_SYS_MEMTEST_END=0x08000000
CONFIG_ENV_ADDR=0x90100000
CONFIG_SYS_MEMTEST_START=0
CONFIG_SF_DEFAULT_BUS=1
CONFIG_SF_DEFAULT_CS=0
CONFIG_NR_DRAM_BANKS=1

CONFIG_BOARD_EARLY_INIT_F=y

CONFIG_FIT=y
CONFIG_FIT_VERBOSE=y
CONFIG_HUSH_PARSER=y
CONFIG_MTD_DEVICE=y
CONFIG_MTD_PARTITIONS=y
CONFIG_OF_CONTROL=y

CONFIG_DM=y
CONFIG_DM_SERIAL=y
CONFIG_NPCMX50_SERIAL=y
CONFIG_TIMER=y
CONFIG_NPCMX50_TIMER=y
CONFIG_CLK=y
CONFIG_CMD_UUID=y
CONFIG_CMD_SAVEENV=y
CONFIG_PINCTRL=y
CONFIG_PINCTRL_NPCM8XX=y
CONFIG_DM_GPIO=y
CONFIG_NPCMX50_GPIO=y
CONFIG_CMD_GPIO=y

CONFIG_USB=y
CONFIG_USB_STORAGE=y
CONFIG_DM_USB=y
CONFIG_CMD_USB=y
CONFIG_USB_EHCI_HCD=y
CONFIG_USB_EHCI_NPCM8XX=y
CONFIG_USB_OHCI_HCD=y
CONFIG_USB_OHCI_GENERIC=y
CONFIG_USB_OHCI_NPCM8XX=y
CONFIG_CMD_FAT=y
CONFIG_FAT_WRITE=y
CONFIG_CI_UDC=y
CONFIG_USB_GADGET=y
CONFIG_USB_GADGET_DOWNLOAD=y
CONFIG_USB_GADGET_MASS_STORAGE=y
CONFIG_CMD_USB_MASS_STORAGE=y
CONFIG_USB_GADGET_MANUFACTURER="Nuvoton"
CONFIG_USB_GADGET_VENDOR_NUM=0x0416
CONFIG_USB_GADGET_PRODUCT_NUM=0xffff

CONFIG_SPI=y
CONFIG_DM_SPI=y
CONFIG_NPCMX50_FIU_SPI=y
CONFIG_DM_SPI_FLASH=y
CONFIG_SPI_FLASH=y
CONFIG_SPI_FLASH_BAR=y
CONFIG_SPI_FLASH_MACRONIX=y
CONFIG_SPI_FLASH_WINBOND=y
CONFIG_CMD_SF=y
CONFIG_CMD_MEMORY=y

CONFIG_CMD_PING=y
CONFIG_CMD_MII=y
CONFIG_NET=y
CONFIG_NETDEVICES=y
CONFIG_PHY_BROADCOM=y
CONFIG_DM_ETH=y
CONFIG_PHY_GIGE=y
CONFIG_ETH_DESIGNWARE=y
CONFIG_RGMII=y
CONFIG_MII=y

CONFIG_MMC=y
CONFIG_DM_MMC=y
CONFIG_MMC_SDHCI_NPCMX50=y
CONFIG_CMD_MMC=y
CONFIG_MMC_SDHCI=y

# CONFIG_EFI is not set
# CONFIG_EFI_LOADER is not set
# CONFIG_ENV_IS_IN_FLASH is not set
# CONFIG_CMD_FLASH is not set
# CONFIG_PSCI_RESET is not set
```

## configs/PolegRunBMC_defconfig
```kconfig
CONFIG_ARM=y
CONFIG_ARCH_NPCM7xx=y
CONFIG_TARGET_POLEG=y
CONFIG_ARCH_NPCM=y
CONFIG_SYS_ARM_ARCH=7
CONFIG_SYS_TEXT_BASE=0x8200
CONFIG_NR_DRAM_BANKS=2
CONFIG_DEFAULT_DEVICE_TREE="nuvoton-npcm750-buv"
CONFIG_ENV_IS_IN_SPI_FLASH=y
CONFIG_ENV_SIZE=0x40000
CONFIG_ENV_SECT_SIZE=0x4000
CONFIG_ENV_OFFSET=0x100000
CONFIG_ENV_ADDR=0x80100000
CONFIG_LAST_STAGE_INIT=y

CONFIG_DM=y
CONFIG_DM_SERIAL=y
CONFIG_NPCM_SERIAL=y
CONFIG_TIMER=y
CONFIG_NPCM_TIMER=y
CONFIG_CLK=y
CONFIG_CMD_UUID=y
CONFIG_CMD_SAVEENV=y
CONFIG_PINCTRL=y
CONFIG_PINCTRL_NPCM7XX=y
CONFIG_PINCONF=y
CONFIG_DM_GPIO=y
CONFIG_NPCM_GPIO=y
CONFIG_CMD_GPIO=y

CONFIG_SPI=y
CONFIG_DM_SPI=y
CONFIG_NPCM_FIU_SPI=y
CONFIG_NPCM_PSPI=y
CONFIG_SF_DEFAULT_BUS=0
CONFIG_SF_DEFAULT_CS=0
CONFIG_DM_SPI_FLASH=y
CONFIG_SPI_FLASH=y
CONFIG_SPI_FLASH_MACRONIX=y
CONFIG_SPI_FLASH_WINBOND=y
CONFIG_CMD_SF=y
CONFIG_CMD_MEMORY=y
CONFIG_CMD_CACHE=y
CONFIG_CMD_SPI=y

CONFIG_MISC=y
CONFIG_NPCM_OTP=y
CONFIG_SHA_HW_ACCEL=y
CONFIG_DM_RNG=y
CONFIG_CMD_AES=y
CONFIG_CMD_RNG=y
CONFIG_CMD_FUSE=y
CONFIG_CMD_HASH=y
CONFIG_NPCM_AES=y
CONFIG_NPCM_RNG=y
CONFIG_NPCM_SHA=y

CONFIG_CMD_PING=y
CONFIG_CMD_MII=y
CONFIG_CMD_DHCP=y
CONFIG_NET=y
CONFIG_NETDEVICES=y
CONFIG_PHY_BROADCOM=y
CONFIG_DM_ETH=y
CONFIG_PHY_GIGE=y
CONFIG_ETH_DESIGNWARE=y
CONFIG_RGMII=y
CONFIG_MII=y
CONFIG_ETH_NPCM750=y
CONFIG_PHY_FIXED=y

CONFIG_MMC=y
CONFIG_DM_MMC=y
CONFIG_CMD_MMC=y
CONFIG_MMC_SDHCI=y
CONFIG_MMC_SDHCI_NPCM=y

CONFIG_DM_I2C=y
CONFIG_NPCM_I2C=y
CONFIG_CMD_I2C=y

CONFIG_FIT=y
CONFIG_FIT_VERBOSE=y

CONFIG_HUSH_PARSER=y

CONFIG_REGMAP=y
CONFIG_SYSCON=y
CONFIG_DM_RESET=y
CONFIG_PHY=y
CONFIG_PHY_NPCM_USB=y
CONFIG_USB=y
CONFIG_USB_STORAGE=y
CONFIG_DM_USB=y
CONFIG_CMD_USB=y
CONFIG_USB_EHCI_HCD=y
CONFIG_USB_EHCI_NPCM=y
CONFIG_USB_OHCI_NEW=y
CONFIG_USB_OHCI_HCD=y
CONFIG_USB_OHCI_NPCM=y
CONFIG_CMD_FAT=y
CONFIG_FAT_WRITE=y
CONFIG_CI_UDC=y
CONFIG_USB_GADGET=y
CONFIG_USB_GADGET_DOWNLOAD=y
CONFIG_USB_GADGET_MASS_STORAGE=y
CONFIG_CMD_USB_MASS_STORAGE=y
CONFIG_USB_GADGET_MANUFACTURER="Nuvoton"
CONFIG_USB_GADGET_VENDOR_NUM=0x0416
CONFIG_USB_GADGET_PRODUCT_NUM=0xffff

CONFIG_WDT=y
CONFIG_WDT_NPCM=y
CONFIG_CMD_WDT=y
# CONFIG_WATCHDOG is not set
```

## configs/PolegSVB_defconfig
```kconfig
CONFIG_ARM=y
CONFIG_ARCH_NPCM750=y
CONFIG_TARGET_POLEG=y
CONFIG_POLEG_SERIAL=y
CONFIG_DEFAULT_DEVICE_TREE="nuvoton-npcm750-evb"
CONFIG_SYS_TEXT_BASE=0x8200
CONFIG_NR_DRAM_BANKS=2
CONFIG_FIT=y
CONFIG_FIT_VERBOSE=y
CONFIG_MTD_DEVICE=y
CONFIG_MTD_PARTITIONS=y
# CONFIG_ENV_IS_IN_FLASH is not set
# CONFIG_CMD_FLASH is not set
CONFIG_CMD_SAVEENV=y
CONFIG_DM=y
CONFIG_DM_SERIAL=y
CONFIG_TIMER=y
CONFIG_NPCM750_TIMER=y
CONFIG_CLK=y
CONFIG_OF_CONTROL=y
CONFIG_OF_LIBFDT=y
CONFIG_LIB_RAND=y
# CONFIG_EFI is not set
# CONFIG_EFI_LOADER is not set
# CONFIG_CMD_IMLS is not set
# CONFIG_CMD_XIMG is not set
CONFIG_SYS_NO_FLASH=y
# CONFIG_MMC is not set
# CONFIG_NETDEVICES is not set
CONFIG_CMD_UUID=y
CONFIG_DM_SPI=y
CONFIG_DM_SPI_FLASH=y
CONFIG_SPI=y
CONFIG_SPI_FLASH=y
CONFIG_SPI_FLASH_MACRONIX=y
CONFIG_NPCM750_FIU_SPI=y
CONFIG_CMD_SF=y
CONFIG_ENV_IS_IN_SPI_FLASH=y
CONFIG_SPI_FLASH_BAR=y
CONFIG_DM_MMC=y
CONFIG_DM_MMC_OPS=y
CONFIG_BLK=y
CONFIG_SDHCI=y
CONFIG_MMC=y
CONFIG_MMC_SDHCI=y
CONFIG_MMC_SDHCI_NPCMX50=y
CONFIG_CMD_MMC=y
```

## configs/PolegSVB_spinor_minimal_defconfig
```kconfig
CONFIG_ARM=y
CONFIG_ARCH_NPCM7xx=y
CONFIG_TARGET_POLEG=y
CONFIG_ARCH_NPCM=y
CONFIG_SYS_ARM_ARCH=7
CONFIG_SYS_TEXT_BASE=0x8200
CONFIG_NR_DRAM_BANKS=2
CONFIG_DEFAULT_DEVICE_TREE="nuvoton-npcm730"
CONFIG_ENV_IS_IN_SPI_FLASH=y
CONFIG_ENV_SIZE=0x40000
CONFIG_ENV_SECT_SIZE=0x4000
CONFIG_ENV_OFFSET=0x100000
CONFIG_ENV_ADDR=0x80100000
CONFIG_LAST_STAGE_INIT=y
CONFIG_SYS_MALLOC_F_LEN=0x1000
CONFIG_FIT=y
CONFIG_FIT_VERBOSE=y
CONFIG_CMD_AES=y
CONFIG_NPCM_AES=y
CONFIG_CMD_FUSE=y
CONFIG_CMD_GPIO=y
CONFIG_CMD_HASH=y
CONFIG_CMD_SF=y
CONFIG_CMD_DHCP=y
CONFIG_CMD_PING=y
CONFIG_CMD_CACHE=y
CONFIG_CMD_RNG=y
CONFIG_CMD_UUID=y
CONFIG_CLK=y
CONFIG_DM_GPIO=y
CONFIG_NPCM_GPIO=y
CONFIG_MISC=y
CONFIG_NPCM_OTP=y
CONFIG_NPCM_RNG=y
CONFIG_NPCM_SHA=y
CONFIG_SHA_HW_ACCEL=y
CONFIG_MTD_DEVICE=y
CONFIG_DM_SPI_FLASH=y
CONFIG_SPI_FLASH=y
CONFIG_SPI_FLASH_BAR=y
CONFIG_SPI_FLASH_MACRONIX=y
CONFIG_SPI_FLASH_WINBOND=y
CONFIG_NET=y
CONFIG_NETDEVICES=y
CONFIG_PHY_BROADCOM=y
CONFIG_DM_ETH=y
CONFIG_PHY_GIGE=y
CONFIG_ETH_DESIGNWARE=y
CONFIG_RGMII=y
CONFIG_MII=y
CONFIG_PHY_FIXED=y
CONFIG_ETH_NPCM750=y
CONFIG_DM_SERIAL=y
CONFIG_NPCM_SERIAL=y
CONFIG_SPI=y
CONFIG_DM_SPI=y
CONFIG_NPCM_FIU_SPI=y
CONFIG_CMD_SPI=y
CONFIG_TIMER=y
CONFIG_NPCM_TIMER=y
CONFIG_PINCTRL_NPCM7XX=y
CONFIG_PINCTRL=y
CONFIG_PINCONF=y
CONFIG_REGMAP=y
CONFIG_SYSCON=y
CONFIG_MMC=y
CONFIG_DM_MMC=y
CONFIG_CMD_MMC=y
CONFIG_USB=y
CONFIG_USB_STORAGE=y
CONFIG_DM_USB=y
CONFIG_CMD_USB=y
# CONFIG_EFI_LOADER is not set
CONFIG_G_DNL_MANUFACTURER="Nuvoton"
CONFIG_G_DNL_VENDOR_NUM=0x0416
CONFIG_G_DNL_PRODUCT_NUM=0xffff
CONFIG_SYS_MEM_TOP_HIDE=0
CONFIG_USE_BOOTCOMMAND=y
CONFIG_BOOTCOMMAND="run common_bootargs; run romboot"
CONFIG_SYS_PROMPT="U-Boot>"
CONFIG_NPCM_SECURE_BOOT=y
CONFIG_RNG_NPCM=y
CONFIG_LIB_HW_RAND=y
```

## configs/arbel_evb_defconfig
```kconfig
CONFIG_ARM=y
CONFIG_ARCH_NPCM=y
CONFIG_ARCH_NPCM8XX=y
CONFIG_TARGET_ARBEL_EVB=y
CONFIG_SYS_TEXT_BASE=0x06208000
CONFIG_DEFAULT_DEVICE_TREE="nuvoton-npcm845-evb"
CONFIG_ENV_IS_IN_SPI_FLASH=y
CONFIG_ENV_SIZE=0x40000
CONFIG_ENV_OFFSET=0x3C0000
CONFIG_ENV_SECT_SIZE=0x1000
CONFIG_CMD_MEMTEST=y
CONFIG_SYS_MEMTEST_START=0
CONFIG_SYS_MEMTEST_END=0x08000000
CONFIG_ENV_ADDR=0x803C0000
CONFIG_SF_DEFAULT_BUS=0
CONFIG_SF_DEFAULT_CS=0
CONFIG_NR_DRAM_BANKS=2
CONFIG_SYS_MALLOC_F_LEN=0x1000
CONFIG_SYS_PROMPT="U-Boot>"

CONFIG_FIT=y
CONFIG_FIT_VERBOSE=y
CONFIG_HUSH_PARSER=y
CONFIG_MTD_DEVICE=y
CONFIG_MTD_PARTITIONS=y
CONFIG_OF_CONTROL=y

CONFIG_DM=y
CONFIG_DM_SERIAL=y
CONFIG_NPCM_SERIAL=y
CONFIG_CLK=y
CONFIG_CMD_UUID=y
CONFIG_CMD_SAVEENV=y
CONFIG_PINCTRL=y
CONFIG_PINCTRL_NPCM8XX=y
CONFIG_PINCONF=y
CONFIG_DM_GPIO=y
CONFIG_NPCM_GPIO=y
CONFIG_CMD_GPIO=y

CONFIG_REGMAP=y
CONFIG_SYSCON=y
CONFIG_DM_RESET=y
CONFIG_RESET_NPCM=y
CONFIG_PHY=y
CONFIG_PHY_NPCM_USB=y
CONFIG_USB=y
CONFIG_USB_STORAGE=y
CONFIG_DM_USB=y
CONFIG_CMD_USB=y
CONFIG_USB_EHCI_HCD=y
CONFIG_USB_EHCI_NPCM=y
CONFIG_USB_OHCI_NEW=y
CONFIG_USB_OHCI_HCD=y
CONFIG_USB_OHCI_NPCM=y
CONFIG_CMD_FAT=y
CONFIG_FAT_WRITE=y
CONFIG_CI_UDC=y
CONFIG_USB_GADGET=y
CONFIG_USB_GADGET_DOWNLOAD=y
CONFIG_USB_GADGET_MASS_STORAGE=y
CONFIG_CMD_USB_MASS_STORAGE=y
CONFIG_USB_GADGET_MANUFACTURER="Nuvoton"
CONFIG_USB_GADGET_VENDOR_NUM=0x0416
CONFIG_USB_GADGET_PRODUCT_NUM=0xffff

CONFIG_SPI=y
CONFIG_DM_SPI=y
CONFIG_NPCM_FIU_SPI=y
CONFIG_NPCM_PSPI=y
CONFIG_DM_SPI_FLASH=y
CONFIG_SPI_FLASH=y
CONFIG_SPI_FLASH_MACRONIX=y
CONFIG_SPI_FLASH_WINBOND=y
# CONFIG_SPI_FLASH_USE_4K_SECTORS is not set
CONFIG_CMD_SF=y
CONFIG_CMD_MEMORY=y
CONFIG_CMD_CACHE=y
CONFIG_CMD_SPI=y

CONFIG_CMD_PING=y
CONFIG_CMD_MII=y
CONFIG_CMD_DHCP=y
CONFIG_NET=y
CONFIG_NETDEVICES=y
CONFIG_PHY_BROADCOM=y
CONFIG_DM_ETH=y
CONFIG_PHY_GIGE=y
CONFIG_ETH_DESIGNWARE=y
CONFIG_RGMII=y
CONFIG_MII=y
CONFIG_BITBANGMII=y

CONFIG_MMC=y
CONFIG_DM_MMC=y
CONFIG_MMC_SDHCI_NPCM=y
CONFIG_CMD_MMC=y
CONFIG_MMC_SDHCI=y

CONFIG_DM_I2C=y
CONFIG_NPCM_I2C=y
CONFIG_CMD_I2C=y

CONFIG_MISC=y
CONFIG_SHA512_ALGO=y
CONFIG_SHA512=y
CONFIG_SHA384=y
CONFIG_SHA_HW_ACCEL=y
CONFIG_SHA512_HW_ACCEL=y
CONFIG_NPCM_SHA=y
CONFIG_RNG_NPCM=y
CONFIG_LIB_HW_RAND=y
CONFIG_DM_RNG=y
CONFIG_CMD_AES=y
CONFIG_CMD_RNG=y
CONFIG_CMD_FUSE=y
CONFIG_CMD_HASH=y
CONFIG_NPCM_AES=y
CONFIG_NPCM_OTP=y

CONFIG_CMD_UNZIP=y
CONFIG_CMD_EXT4=y
CONFIG_CMD_GPT=y
CONFIG_CMD_FS_GENERIC=y
CONFIG_CMD_PART=y
CONFIG_PARTITION_UUIDS=y
CONFIG_EFI_PARTITION=y

CONFIG_DM_REGULATOR=y
CONFIG_DM_REGULATOR_NPCM8XX=y

# CONFIG_EFI is not set
# CONFIG_EFI_LOADER is not set
# CONFIG_ENV_IS_IN_FLASH is not set
# CONFIG_CMD_FLASH is not set
# CONFIG_PSCI_RESET is not set
# CONFIG_INPUT is not set

CONFIG_SPI_FLASH_GOOGLE=y
CONFIG_TEE=y
CONFIG_OPTEE=y
CONFIG_TPM=y
CONFIG_TPM_V2=y
CONFIG_TPM2_FTPM_TEE=y
CONFIG_CMD_TPM=y
CONFIG_TPM2_MB=y
CONFIG_SUPPORT_EMMC_RPMB=y
CONFIG_LAST_STAGE_INIT=y
```

## drivers/crypto/Kconfig
```kconfig
menu "Hardware crypto devices"

source drivers/crypto/fsl/Kconfig

config NPCMX50_AES
	bool "Support the NPCMX50 AES algorithm"
	select NPCMX50_OTP
	help
	  This provides a means to encrypt and decrypt data using the NPCM750
	  AES (Advanced Encryption Standard). This algorithm uses a symetric
	  key and is widely used as a streaming cipher. This command only
	  supports AES256-CBC.

config NPCMX50_SHA
	bool "Enable NPCMX50 cryptographic HW SHA accelerator"
	help
	  This option enables support of NPCMX50 cryptographic HW SHA accelerator.
	  It supports SHA1 and SHA256 hashing algorithms.

endmenu
```

## drivers/pinctrl/nuvoton/Kconfig
```kconfig
# SPDX-License-Identifier: GPL-2.0-only
config PINCTRL_NPCM7XX
	bool "Pinctrl and GPIO driver for Nuvoton NPCM7XX"
	depends on DM && PINCTRL_GENERIC && ARCH_NPCM7xx
	help
	  Say Y here to enable pin controller and GPIO support
	  for Nuvoton NPCM750/730/715/705 SoCs.

config PINCTRL_NPCM8XX
	bool "Pinctrl and GPIO driver for Nuvoton NPCM8XX"
	depends on DM && PINCTRL_GENERIC && ARCH_NPCM8XX
	help
	  Say Y here to enable pin controller and GPIO support
	  for Nuvoton NPCM845 SoC.
```
