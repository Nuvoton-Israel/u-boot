## arch/arm/mach-npcm/npcm9xx/Kconfig
```kconfig
if ARCH_NPCM9XX

config SYS_CPU
	default "armv8"

config SYS_SOC
	default "npcm9xx"

config SYS_NPCM_DCACHE_OFF
	bool "Do not enable dcache"
	default n


choice
	prompt "Tavor board select"
	default TARGET_TAVOR_EVB

config TARGET_TAVOR_EVB
	bool "Tavor Evaluation Board"
	help
	  TARGET_TAVOR_EVB is Nuvoton evaluation board for NPCM945 SoC,
	  supports general functions of Basebase Management Controller
	  (BMC).

config TARGET_TAVOR_VELOCE
	bool "Tavor Veloce Simulation"
	help
	  TARGET_TAVOR_VELOCE is Nuvoton simulation on Veloce.

endchoice

source "board/nuvoton/tavor_evb/Kconfig"

endif
```

## board/nuvoton/tavor_evb/Kconfig
```kconfig
if TARGET_ARBEL_EVB || TARGET_TAVOR_VELOCE

config SYS_BOARD
	default "tavor_evb"

config SYS_VENDOR
	default "nuvoton"

config SYS_CONFIG_NAME
	default "tavor"

config SYS_MEM_TOP_HIDE
	hex "Reserved TOP memory"
	default 0x0
	help
	  Reserve memory for ECC/GFX/OPTEE/TIP/CP.

source "board/nuvoton/common/Kconfig"
endif
```

## configs/tavor_veloce_fiu_mmc_moc_ddr_usb_net_defconfig
```kconfig
CONFIG_ARM=y
CONFIG_ARM_SMCCC=y
CONFIG_ARCH_NPCM=y
CONFIG_TEXT_BASE=0x80100000
CONFIG_SYS_MALLOC_LEN=0x80000
CONFIG_SYS_MALLOC_F_LEN=0x1000
CONFIG_NR_DRAM_BANKS=2
CONFIG_HAS_CUSTOM_SYS_INIT_SP_ADDR=y
CONFIG_CUSTOM_SYS_INIT_SP_ADDR=0x80200000
CONFIG_SYS_MEM_TOP_HIDE=0x100000
CONFIG_ENV_SIZE=0x4000
CONFIG_DEFAULT_DEVICE_TREE="nuvoton-npcm945-veloce"
CONFIG_DM_GPIO=y
# CONFIG_PSCI_RESET is not set
CONFIG_ARCH_NPCM9XX=y
CONFIG_TARGET_TAVOR_VELOCE=y
CONFIG_SYS_LOAD_ADDR=0x80100000
CONFIG_STACK_SIZE=0x4000
# CONFIG_LEGACY_IMAGE_FORMAT is not set
CONFIG_AUTOBOOT=y
CONFIG_BOOTDELAY=0
CONFIG_USE_BOOTCOMMAND=y
CONFIG_BOOTCOMMAND=""
# CONFIG_DISPLAY_CPUINFO is not set
# CONFIG_DISPLAY_BOARDINFO is not set
CONFIG_LAST_STAGE_INIT=y
CONFIG_HUSH_PARSER=y
CONFIG_SYS_PROMPT="U-Boot>"
CONFIG_SYS_MAXARGS=32
CONFIG_SYS_BOOTM_LEN=0x1400000
CONFIG_CMD_BOOTI=y
CONFIG_CMD_FAT=y
CONFIG_CMD_GFX=y
CONFIG_CMD_MEMTEST=y
CONFIG_CMD_GPIO=y
CONFIG_CMD_GPT=y
CONFIG_CMD_MMC=y
CONFIG_MMC_HS200_SUPPORT=y
CONFIG_MMC_HS400_SUPPORT=y
CONFIG_MMC_HS400_ES_SUPPORT=y
CONFIG_CMD_PART=y
CONFIG_CMD_SPI=y
CONFIG_CMD_USB=y
CONFIG_CMD_USB_MASS_STORAGE=y
CONFIG_CMD_DHCP=y
CONFIG_CMD_DHCP6=y
CONFIG_BOOTP_PXE_DHCP_OPTION=y
CONFIG_DHCP6_PXE_DHCP_OPTION=y
CONFIG_DHCP6_ENTERPRISE_ID=311
CONFIG_CMD_MII=y
CONFIG_CMD_PING=y
CONFIG_IPV6_ROUTER_DISCOVERY=y
CONFIG_CMD_PXE=y
CONFIG_CMD_CACHE=y
CONFIG_CMD_RNG=y
CONFIG_OF_EMBED=y
CONFIG_CMD_EXT4=y
CONFIG_CMD_GFX=y
CONFIG_CMD_FAT=y
CONFIG_CMD_FS_GENERIC=y
CONFIG_NET_RETRY_COUNT=6
CONFIG_IPV6=y
CONFIG_REGMAP=y
CONFIG_SYSCON=y
CONFIG_NPCM_GPIO=y
CONFIG_NPCM_SGPIO=y
# CONFIG_INPUT is not set
CONFIG_MISC=y

CONFIG_SUPPORT_EMMC_RPMB=y
CONFIG_MMC_SDHCI=y
CONFIG_MMC_SDHCI_NPCM=y
CONFIG_MTD=y
CONFIG_DM_SPI_FLASH=y
CONFIG_SPI_FLASH_MACRONIX=y
CONFIG_SPI_FLASH_WINBOND=y
# CONFIG_SPI_FLASH_USE_4K_SECTORS is not set
CONFIG_BITBANGMII=y
CONFIG_BITBANGMII_MULTI=y
CONFIG_PHY_BROADCOM=y
CONFIG_PHY_GIGE=y
CONFIG_DWC_ETH_XGMAC=y
CONFIG_DWC_ETH_XGMAC_NUVOTON_NPCM9XX=y
CONFIG_ETH_DESIGNWARE=y
CONFIG_RGMII=y
CONFIG_MII=y
CONFIG_PHY_NPCM_USB=y
CONFIG_DM_RNG=y
CONFIG_RNG_NPCM=y
CONFIG_DM_SERIAL=y
CONFIG_NPCM_SERIAL=y
CONFIG_SPI=y
CONFIG_DM_SPI=y
CONFIG_NPCM_FIU_SPI=y
CONFIG_USB=y
CONFIG_USB_XHCI_HCD=y
CONFIG_USB_XHCI_NPCM=y
CONFIG_USB_STORAGE=y
CONFIG_USB_XHCI_DWC3=y
CONFIG_USB_DWC3=y
CONFIG_USB_DWC3_GADGET=y
CONFIG_USB_DWC3_GENERIC=y
CONFIG_USB_GADGET=y
CONFIG_USB_GADGET_MANUFACTURER="Nuvoton"
CONFIG_USB_GADGET_VENDOR_NUM=0x0416
CONFIG_USB_GADGET_PRODUCT_NUM=0xfffe
CONFIG_USB_FUNCTION_MASS_STORAGE=y
CONFIG_CMD_USB_MASS_STORAGE=y
CONFIG_DM_USB_GADGET=y
CONFIG_USB_GADGET_DOWNLOAD=y
CONFIG_PHY_FIXED=y

# CONFIG_GZIP is not set
CONFIG_LMB=y
CONFIG_SYS_SKIP_UART_INIT=y
CONFIG_LIB_HW_RAND=y
```

## configs/tavor_veloce_moc_ddr_usb_defconfig
```kconfig
CONFIG_ARM=y
CONFIG_ARM_SMCCC=y
CONFIG_ARCH_NPCM=y
CONFIG_TEXT_BASE=0x80100000
CONFIG_SYS_MALLOC_LEN=0x80000
CONFIG_SYS_MALLOC_F_LEN=0x1000
CONFIG_NR_DRAM_BANKS=2
CONFIG_HAS_CUSTOM_SYS_INIT_SP_ADDR=y
CONFIG_CUSTOM_SYS_INIT_SP_ADDR=0x80200000
CONFIG_SYS_MEM_TOP_HIDE=0x100000
CONFIG_ENV_SIZE=0x4000
CONFIG_DEFAULT_DEVICE_TREE="nuvoton-npcm945-veloce"
# CONFIG_PSCI_RESET is not set
CONFIG_ARCH_NPCM9XX=y
CONFIG_TARGET_TAVOR_VELOCE=y
CONFIG_SYS_LOAD_ADDR=0x80100000
CONFIG_STACK_SIZE=0x4000
# CONFIG_LEGACY_IMAGE_FORMAT is not set
# CONFIG_AUTOBOOT is not set
CONFIG_USE_BOOTCOMMAND=y
CONFIG_BOOTCOMMAND="run common_bootargs; run romboot"
# CONFIG_DISPLAY_CPUINFO is not set
# CONFIG_DISPLAY_BOARDINFO is not set
CONFIG_LAST_STAGE_INIT=y
CONFIG_HUSH_PARSER=y
CONFIG_SYS_PROMPT="U-Boot>"
CONFIG_SYS_MAXARGS=32
CONFIG_SYS_BOOTM_LEN=0x1400000
# CONFIG_CMD_BOOTD is not set
# CONFIG_CMD_BOOTI is not set
# CONFIG_CMD_ELF is not set
# CONFIG_CMD_FDT is not set
# CONFIG_CMD_GO is not set
# CONFIG_CMD_RUN is not set
# CONFIG_CMD_IMI is not set
# CONFIG_CMD_XIMG is not set
# CONFIG_CMD_EXPORTENV is not set
# CONFIG_CMD_IMPORTENV is not set
# CONFIG_CMD_EDITENV is not set
# CONFIG_CMD_SAVEENV is not set
# CONFIG_CMD_ENV_EXISTS is not set
# CONFIG_CMD_CRC32 is not set
CONFIG_CMD_MEMTEST=y
CONFIG_CMD_USB=y
CONFIG_CMD_USB_MASS_STORAGE=y

# CONFIG_CMD_DM is not set
# CONFIG_CMD_LOADB is not set
# CONFIG_CMD_LOADS is not set
# CONFIG_CMD_ITEST is not set
# CONFIG_CMD_SOURCE is not set
# CONFIG_CMD_SETEXPR is not set
CONFIG_CMD_CACHE=y
CONFIG_OF_EMBED=y
# CONFIG_NET is not set
CONFIG_REGMAP=y
CONFIG_SYSCON=y
# CONFIG_GPIO is not set
# CONFIG_I2C is not set
# CONFIG_INPUT is not set
CONFIG_MISC=y
# CONFIG_MMC is not set
# CONFIG_POWER is not set
CONFIG_PHY_NPCM_USB=y
CONFIG_DM_SERIAL=y
CONFIG_NPCM_SERIAL=y
CONFIG_USB=y
CONFIG_USB_XHCI_HCD=y
CONFIG_USB_XHCI_NPCM=y
CONFIG_USB_STORAGE=y

# CONFIG_GZIP is not set
# CONFIG_LMB is not set
CONFIG_SYS_SKIP_UART_INIT=y
```

## configs/tavor_veloce_moc_ddr_usb_net_defconfig
```kconfig
CONFIG_ARM=y
CONFIG_ARM_SMCCC=y
CONFIG_ARCH_NPCM=y
CONFIG_TEXT_BASE=0x80100000
CONFIG_SYS_MALLOC_LEN=0x80000
CONFIG_SYS_MALLOC_F_LEN=0x1000
CONFIG_NR_DRAM_BANKS=2
CONFIG_HAS_CUSTOM_SYS_INIT_SP_ADDR=y
CONFIG_CUSTOM_SYS_INIT_SP_ADDR=0x80200000
CONFIG_SYS_MEM_TOP_HIDE=0x100000
CONFIG_ENV_SIZE=0x4000
CONFIG_DEFAULT_DEVICE_TREE="nuvoton-npcm945-veloce"
CONFIG_DM_GPIO=y
# CONFIG_PSCI_RESET is not set
CONFIG_ARCH_NPCM9XX=y
CONFIG_TARGET_TAVOR_VELOCE=y
CONFIG_SYS_LOAD_ADDR=0x80100000
CONFIG_STACK_SIZE=0x4000
# CONFIG_LEGACY_IMAGE_FORMAT is not set
CONFIG_AUTOBOOT=y
CONFIG_BOOTDELAY=0
CONFIG_USE_BOOTCOMMAND=y
CONFIG_BOOTCOMMAND="run common_bootargs; run romboot"
# CONFIG_DISPLAY_CPUINFO is not set
# CONFIG_DISPLAY_BOARDINFO is not set
CONFIG_LAST_STAGE_INIT=y
CONFIG_HUSH_PARSER=y
CONFIG_SYS_PROMPT="U-Boot>"
CONFIG_SYS_MAXARGS=32
CONFIG_SYS_BOOTM_LEN=0x1400000
# CONFIG_CMD_BOOTD is not set
CONFIG_CMD_BOOTI=y
# CONFIG_CMD_ELF is not set
# CONFIG_CMD_FDT is not set
# CONFIG_CMD_GO is not set
# CONFIG_CMD_RUN is not set
# CONFIG_CMD_IMI is not set
# CONFIG_CMD_XIMG is not set
# CONFIG_CMD_EXPORTENV is not set
# CONFIG_CMD_IMPORTENV is not set
# CONFIG_CMD_EDITENV is not set
# CONFIG_CMD_SAVEENV is not set
# CONFIG_CMD_ENV_EXISTS is not set
# CONFIG_CMD_CRC32 is not set
CONFIG_CMD_FAT=y
CONFIG_CMD_GFX=y
CONFIG_CMD_MEMTEST=y
CONFIG_CMD_GPIO=y
CONFIG_CMD_USB=y
CONFIG_CMD_USB_MASS_STORAGE=y
CONFIG_CMD_DHCP=y
CONFIG_CMD_DHCP6=y
CONFIG_BOOTP_PXE_DHCP_OPTION=y
CONFIG_DHCP6_PXE_DHCP_OPTION=y
CONFIG_DHCP6_ENTERPRISE_ID=311
CONFIG_CMD_MII=y
CONFIG_CMD_PING=y
CONFIG_IPV6_ROUTER_DISCOVERY=y
CONFIG_CMD_PXE=y
# CONFIG_CMD_DM is not set
# CONFIG_CMD_LOADB is not set
# CONFIG_CMD_LOADS is not set
# CONFIG_CMD_ITEST is not set
# CONFIG_CMD_SOURCE is not set
# CONFIG_CMD_SETEXPR is not set
CONFIG_CMD_CACHE=y
CONFIG_CMD_RNG=y
CONFIG_OF_EMBED=y
CONFIG_NET_RETRY_COUNT=6
CONFIG_IPV6=y
CONFIG_REGMAP=y
CONFIG_SYSCON=y
CONFIG_NPCM_GPIO=y
CONFIG_NPCM_SGPIO=y
# CONFIG_INPUT is not set
CONFIG_MISC=y
# CONFIG_MMC is not set
# CONFIG_POWER is not set
CONFIG_BITBANGMII=y
CONFIG_BITBANGMII_MULTI=y
CONFIG_PHY_BROADCOM=y
CONFIG_PHY_GIGE=y
CONFIG_ETH_DESIGNWARE=y
CONFIG_RGMII=y
CONFIG_MII=y
CONFIG_PHY_NPCM_USB=y
CONFIG_DM_RNG=y
CONFIG_RNG_NPCM=y
CONFIG_DM_SERIAL=y
CONFIG_NPCM_SERIAL=y
CONFIG_USB=y
CONFIG_USB_XHCI_HCD=y
CONFIG_USB_XHCI_NPCM=y
CONFIG_USB_STORAGE=y
CONFIG_USB_XHCI_DWC3=y
CONFIG_USB_DWC3=y
CONFIG_USB_DWC3_GADGET=y
CONFIG_USB_DWC3_GENERIC=y
CONFIG_USB_GADGET=y
CONFIG_USB_GADGET_MANUFACTURER="Nuvoton"
CONFIG_USB_GADGET_VENDOR_NUM=0x0416
CONFIG_USB_GADGET_PRODUCT_NUM=0xfffe
CONFIG_USB_FUNCTION_MASS_STORAGE=y
CONFIG_CMD_USB_MASS_STORAGE=y
CONFIG_DM_USB_GADGET=y
CONFIG_USB_GADGET_DOWNLOAD=y
CONFIG_PHY_FIXED=y

# CONFIG_GZIP is not set
# CONFIG_LMB is not set
CONFIG_SYS_SKIP_UART_INIT=y
CONFIG_LIB_HW_RAND=y
```
